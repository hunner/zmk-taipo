#include <zmk-taipo/adapters/zmk_helpers.h>

#define ZMK_TAIPO_CORE_INCLUDED 1

#ifndef TAIPO_COMBO_TERM_FAST
#define TAIPO_COMBO_TERM_FAST 100
#endif

#ifndef TAIPO_COMBO_TERM_SLOW
#define TAIPO_COMBO_TERM_SLOW 80
#endif

#ifndef COMBO_TERM_FAST
#define COMBO_TERM_FAST TAIPO_COMBO_TERM_FAST
#endif

#ifndef COMBO_TERM_SLOW
#define COMBO_TERM_SLOW TAIPO_COMBO_TERM_SLOW
#endif

// Choose one:
// - TAIPO_THUMB_ORDER_IOOI (inner-outer-outer-inner)
// - TAIPO_THUMB_ORDER_OIIO (outer-inner-inner-outer)
// Default: OIIO
// IOOI means that the inner thumbs are closer to the inside of your hands
// OIIO means that the inner thumbs are closer to the inside of your keyboard
#if !defined(TAIPO_THUMB_ORDER_IOOI) && !defined(TAIPO_THUMB_ORDER_OIIO)
#define TAIPO_THUMB_ORDER_OIIO 1
#endif

#if defined(TAIPO_THUMB_ORDER_IOOI) && defined(TAIPO_THUMB_ORDER_OIIO)
#error "Define only one of TAIPO_THUMB_ORDER_IOOI or TAIPO_THUMB_ORDER_OIIO"
#endif

#if defined(TAIPO_THUMB_ORDER_IOOI)
#define INNER_THUMB_L TAIPO_POS_H1
#define OUTER_THUMB_L TAIPO_POS_H2
#define OUTER_THUMB_R TAIPO_POS_H3
#define INNER_THUMB_R TAIPO_POS_H4
#elif defined(TAIPO_THUMB_ORDER_OIIO)
#define OUTER_THUMB_L TAIPO_POS_H1
#define INNER_THUMB_L TAIPO_POS_H2
#define INNER_THUMB_R TAIPO_POS_H3
#define OUTER_THUMB_R TAIPO_POS_H4
#else
#error "You must define either TAIPO_THUMB_ORDER_IOOI or TAIPO_THUMB_ORDER_OIIO"
#endif

#define ITL INNER_THUMB_L
#define OTL OUTER_THUMB_L
#define ITR INNER_THUMB_R
#define OTR OUTER_THUMB_R

#ifndef TAIPO
#error "A layer TAIPO must be defined before including taipo.dtsi"
#endif

#define TAIPO_MAP_L_1(x) TAIPO_POS_L##x
#define TAIPO_MAP_L_2(x, y) TAIPO_POS_L##x TAIPO_POS_L##y
#define TAIPO_MAP_L_3(x, y, z) TAIPO_POS_L##x TAIPO_POS_L##y TAIPO_POS_L##z
#define TAIPO_MAP_L_4(x, y, z, w) TAIPO_POS_L##x TAIPO_POS_L##y TAIPO_POS_L##z TAIPO_POS_L##w
#define TAIPO_MAP_L_5(x, y, z, w, v) TAIPO_POS_L##x TAIPO_POS_L##y TAIPO_POS_L##z TAIPO_POS_L##w TAIPO_POS_L##v
#define TAIPO_MAP_L_6(x, y, z, w, v, u) TAIPO_POS_L##x TAIPO_POS_L##y TAIPO_POS_L##z TAIPO_POS_L##w TAIPO_POS_L##v TAIPO_POS_L##u
#define TAIPO_MAP_L_7(x, y, z, w, v, u, t) TAIPO_POS_L##x TAIPO_POS_L##y TAIPO_POS_L##z TAIPO_POS_L##w TAIPO_POS_L##v TAIPO_POS_L##u TAIPO_POS_L##t
#define TAIPO_MAP_L_8(x, y, z, w, v, u, t, s) TAIPO_POS_L##x TAIPO_POS_L##y TAIPO_POS_L##z TAIPO_POS_L##w TAIPO_POS_L##v TAIPO_POS_L##u TAIPO_POS_L##t TAIPO_POS_L##s

#define TAIPO_MAP_R_1(x) TAIPO_POS_R##x
#define TAIPO_MAP_R_2(x, y) TAIPO_POS_R##x TAIPO_POS_R##y
#define TAIPO_MAP_R_3(x, y, z) TAIPO_POS_R##x TAIPO_POS_R##y TAIPO_POS_R##z
#define TAIPO_MAP_R_4(x, y, z, w) TAIPO_POS_R##x TAIPO_POS_R##y TAIPO_POS_R##z TAIPO_POS_R##w
#define TAIPO_MAP_R_5(x, y, z, w, v) TAIPO_POS_R##x TAIPO_POS_R##y TAIPO_POS_R##z TAIPO_POS_R##w TAIPO_POS_R##v
#define TAIPO_MAP_R_6(x, y, z, w, v, u) TAIPO_POS_R##x TAIPO_POS_R##y TAIPO_POS_R##z TAIPO_POS_R##w TAIPO_POS_R##v TAIPO_POS_R##u
#define TAIPO_MAP_R_7(x, y, z, w, v, u, t) TAIPO_POS_R##x TAIPO_POS_R##y TAIPO_POS_R##z TAIPO_POS_R##w TAIPO_POS_R##v TAIPO_POS_R##u TAIPO_POS_R##t
#define TAIPO_MAP_R_8(x, y, z, w, v, u, t, s) TAIPO_POS_R##x TAIPO_POS_R##y TAIPO_POS_R##z TAIPO_POS_R##w TAIPO_POS_R##v TAIPO_POS_R##u TAIPO_POS_R##t TAIPO_POS_R##s

// Lowercase aliases keep taipo position tokens distinct from ZMK keycode macros
// like E/T/O/A/I/N/S/R from <dt-bindings/zmk/keys.h>.
#define TAIPO_POS_Le TAIPO_POS_LE
#define TAIPO_POS_Lt TAIPO_POS_LT
#define TAIPO_POS_Lo TAIPO_POS_LO
#define TAIPO_POS_La TAIPO_POS_LA
#define TAIPO_POS_Li TAIPO_POS_LI
#define TAIPO_POS_Ln TAIPO_POS_LN
#define TAIPO_POS_Ls TAIPO_POS_LS
#define TAIPO_POS_Lr TAIPO_POS_LR

#define TAIPO_POS_Re TAIPO_POS_RE
#define TAIPO_POS_Rt TAIPO_POS_RT
#define TAIPO_POS_Ro TAIPO_POS_RO
#define TAIPO_POS_Ra TAIPO_POS_RA
#define TAIPO_POS_Ri TAIPO_POS_RI
#define TAIPO_POS_Rn TAIPO_POS_RN
#define TAIPO_POS_Rs TAIPO_POS_RS
#define TAIPO_POS_Rr TAIPO_POS_RR

#define TAIPO_GET_KEYS(_1,_2,_3,_4,_5,_6,_7,_8,NAME,...) NAME
#define TAIPO_MAP_L(...) TAIPO_GET_KEYS(__VA_ARGS__, TAIPO_MAP_L_8, TAIPO_MAP_L_7, TAIPO_MAP_L_6, TAIPO_MAP_L_5, TAIPO_MAP_L_4, TAIPO_MAP_L_3, TAIPO_MAP_L_2, TAIPO_MAP_L_1)(__VA_ARGS__)
#define TAIPO_MAP_R(...) TAIPO_GET_KEYS(__VA_ARGS__, TAIPO_MAP_R_8, TAIPO_MAP_R_7, TAIPO_MAP_R_6, TAIPO_MAP_R_5, TAIPO_MAP_R_4, TAIPO_MAP_R_3, TAIPO_MAP_R_2, TAIPO_MAP_R_1)(__VA_ARGS__)

#if TAIPO_ONLY_RIGHT_HAND
#define TAIPO_IF_LEFT(...)
#define TAIPO_IF_RIGHT(...) __VA_ARGS__
#elif TAIPO_ONLY_LEFT_HAND
#define TAIPO_IF_LEFT(...) __VA_ARGS__
#define TAIPO_IF_RIGHT(...)
#else
#define TAIPO_IF_LEFT(...) __VA_ARGS__
#define TAIPO_IF_RIGHT(...) __VA_ARGS__
#endif

// Macros to expand into left/right combos and virtual thumb variants.
#define ZMK_COMBO_TAIPO(name, kp, ...) \
    TAIPO_IF_LEFT(ZMK_COMBO(taipoL##name, kp, TAIPO_MAP_L(__VA_ARGS__), TAIPO, TAIPO_COMBO_TERM_FAST)) \
    TAIPO_IF_RIGHT(ZMK_COMBO(taipoR##name, kp, TAIPO_MAP_R(__VA_ARGS__), TAIPO, TAIPO_COMBO_TERM_FAST))

#define ZMK_COMBO_TAIPO_IT(name, kp, ...) \
    TAIPO_IF_LEFT(ZMK_COMBO(taipoLIT##name, kp, TAIPO_MAP_L(__VA_ARGS__) ITL, TAIPO, TAIPO_COMBO_TERM_FAST)) \
    TAIPO_IF_RIGHT(ZMK_COMBO(taipoRIT##name, kp, TAIPO_MAP_R(__VA_ARGS__) ITR, TAIPO, TAIPO_COMBO_TERM_FAST)) \
    #ifdef TAIPO_INNER \
    TAIPO_IF_LEFT(ZMK_COMBO(taipoLIV##name, kp, TAIPO_MAP_L(__VA_ARGS__), TAIPO_INNER, TAIPO_COMBO_TERM_FAST)) \
    TAIPO_IF_RIGHT(ZMK_COMBO(taipoRIV##name, kp, TAIPO_MAP_R(__VA_ARGS__), TAIPO_INNER, TAIPO_COMBO_TERM_FAST)) \
    #endif

#define ZMK_COMBO_TAIPO_OT(name, kp, ...) \
    TAIPO_IF_LEFT(ZMK_COMBO(taipoLOT##name, kp, TAIPO_MAP_L(__VA_ARGS__) OTL, TAIPO, TAIPO_COMBO_TERM_FAST)) \
    TAIPO_IF_RIGHT(ZMK_COMBO(taipoROT##name, kp, TAIPO_MAP_R(__VA_ARGS__) OTR, TAIPO, TAIPO_COMBO_TERM_FAST)) \
    #ifdef TAIPO_OUTER \
    TAIPO_IF_LEFT(ZMK_COMBO(taipoLOV##name, kp, TAIPO_MAP_L(__VA_ARGS__), TAIPO_OUTER, TAIPO_COMBO_TERM_FAST)) \
    TAIPO_IF_RIGHT(ZMK_COMBO(taipoROV##name, kp, TAIPO_MAP_R(__VA_ARGS__), TAIPO_OUTER, TAIPO_COMBO_TERM_FAST)) \
    #endif

ZMK_COMBO(taipoLspace   , &kp SPACE, ITL, TAIPO, TAIPO_COMBO_TERM_FAST)
ZMK_COMBO(taipoRspace   , &kp SPACE, ITR, TAIPO, TAIPO_COMBO_TERM_FAST)
ZMK_COMBO(taipoLbspace  , &kp BSPC , OTL, TAIPO, TAIPO_COMBO_TERM_FAST)
ZMK_COMBO(taipoRbspace  , &kp BSPC , OTR, TAIPO, TAIPO_COMBO_TERM_FAST)

ZMK_COMBO_TAIPO(e       , &kp E    , e)
ZMK_COMBO_TAIPO(t       , &kp T    , t)
ZMK_COMBO_TAIPO(o       , &kp O    , o)
ZMK_COMBO_TAIPO(a       , &kp A    , a)

ZMK_COMBO_TAIPO(i       , &kp I    , i)
ZMK_COMBO_TAIPO(n       , &kp N    , n)
ZMK_COMBO_TAIPO(s       , &kp S    , s)
ZMK_COMBO_TAIPO(r       , &kp R    , r)

ZMK_COMBO_TAIPO_IT(cape , &kp LS(E), e)
ZMK_COMBO_TAIPO_IT(capt , &kp LS(T), t)
ZMK_COMBO_TAIPO_IT(capo , &kp LS(O), o)
ZMK_COMBO_TAIPO_IT(capa , &kp LS(A), a)

ZMK_COMBO_TAIPO_OT(lpar , &kp LPAR , e)
ZMK_COMBO_TAIPO_OT(lbkt , &kp LBKT , t)
ZMK_COMBO_TAIPO_OT(lbrc , &kp LBRC , o)
ZMK_COMBO_TAIPO_OT(lt   , &kp LT   , a)

ZMK_COMBO_TAIPO_IT(capi , &kp LS(I), i)
ZMK_COMBO_TAIPO_IT(capn , &kp LS(N), n)
ZMK_COMBO_TAIPO_IT(caps , &kp LS(S), s)
ZMK_COMBO_TAIPO_IT(capr , &kp LS(R), r)

ZMK_COMBO_TAIPO_OT(rpar , &kp RPAR , i)
ZMK_COMBO_TAIPO_OT(rbkt , &kp RBKT , n)
ZMK_COMBO_TAIPO_OT(rbrc , &kp RBRC , s)
ZMK_COMBO_TAIPO_OT(gt   , &kp GT   , r)

ZMK_COMBO_TAIPO(h       , &kp H    , e, t)
ZMK_COMBO_TAIPO(l       , &kp L    , o, a)
ZMK_COMBO_TAIPO(y       , &kp Y    , i, n)
ZMK_COMBO_TAIPO(b       , &kp B    , s, r)

ZMK_COMBO_TAIPO_IT(caph , &kp LS(H), e, t)
ZMK_COMBO_TAIPO_IT(capl , &kp LS(L), o, a)
ZMK_COMBO_TAIPO_IT(capy , &kp LS(Y), i, n)
ZMK_COMBO_TAIPO_IT(capb , &kp LS(B), s, r)

ZMK_COMBO_TAIPO_OT(n0   , &kp N0   , e, t)
ZMK_COMBO_TAIPO_OT(n4   , &kp N4   , o, a)
ZMK_COMBO_TAIPO_OT(n5   , &kp N5   , i, n)
ZMK_COMBO_TAIPO_OT(n9   , &kp N9   , s, r)

ZMK_COMBO_TAIPO(g       , &kp G    , i, r)
ZMK_COMBO_TAIPO(u       , &kp U    , t, o)
ZMK_COMBO_TAIPO(d       , &kp D    , e, a)
ZMK_COMBO_TAIPO(p       , &kp P    , n, s)

ZMK_COMBO_TAIPO_IT(capg , &kp LS(G), i, r)
ZMK_COMBO_TAIPO_IT(capu , &kp LS(U), t, o)
ZMK_COMBO_TAIPO_IT(capd , &kp LS(D), e, a)
ZMK_COMBO_TAIPO_IT(capp , &kp LS(P), n, s)

ZMK_COMBO_TAIPO_OT(hash , &kp HASH , i, r)
ZMK_COMBO_TAIPO_OT(n2   , &kp N2   , t, o)
ZMK_COMBO_TAIPO_OT(a    , &kp AT   , e, a)
ZMK_COMBO_TAIPO_OT(n7   , &kp N7   , n, s)

ZMK_COMBO_TAIPO(c       , &kp C    , e, o)
ZMK_COMBO_TAIPO(q       , &kp Q    , t, a)
ZMK_COMBO_TAIPO(f       , &kp F    , i, s)
ZMK_COMBO_TAIPO(z       , &kp Z    , n, r)

ZMK_COMBO_TAIPO_IT(capc , &kp LS(C), e, o)
ZMK_COMBO_TAIPO_IT(capq , &kp LS(Q), t, a)
ZMK_COMBO_TAIPO_IT(capf , &kp LS(F), i, s)
ZMK_COMBO_TAIPO_IT(capz , &kp LS(Z), n, r)

ZMK_COMBO_TAIPO_OT(n1   , &kp N1   , e, o)
ZMK_COMBO_TAIPO_OT(n3   , &kp N3   , t, a)
ZMK_COMBO_TAIPO_OT(n6   , &kp N6   , i, s)
ZMK_COMBO_TAIPO_OT(n8   , &kp N8   , n, r)

ZMK_COMBO_TAIPO(v       , &kp V    , e, s)
ZMK_COMBO_TAIPO(x       , &kp X    , t, r)
ZMK_COMBO_TAIPO(k       , &kp K    , i, o)
ZMK_COMBO_TAIPO(j       , &kp J    , n, a)

ZMK_COMBO_TAIPO_IT(capv , &kp LS(V), e, s)
ZMK_COMBO_TAIPO_IT(capx , &kp LS(X), t, r)
ZMK_COMBO_TAIPO_IT(capk , &kp LS(K), i, o)
ZMK_COMBO_TAIPO_IT(capj , &kp LS(J), n, a)

ZMK_COMBO_TAIPO_OT(star , &kp STAR , e, s)
ZMK_COMBO_TAIPO_OT(caret, &kp CARET, t, r)
ZMK_COMBO_TAIPO_OT(plus , &kp PLUS , i, o)
ZMK_COMBO_TAIPO_OT(equal, &kp EQUAL, n, a)

ZMK_COMBO_TAIPO(minus   , &kp MINUS, n, o)
ZMK_COMBO_TAIPO(w       , &kp W    , i, a)
ZMK_COMBO_TAIPO(m       , &kp M    , e, r)
ZMK_COMBO_TAIPO(slash   , &kp SLASH, t, s)

ZMK_COMBO_TAIPO_IT(under, &kp UNDER, n, o)
ZMK_COMBO_TAIPO_IT(capw , &kp LS(W), i, a)
ZMK_COMBO_TAIPO_IT(capm , &kp LS(M), e, r)
ZMK_COMBO_TAIPO_IT(bslh , &kp BSLH , t, s)

ZMK_COMBO_TAIPO_OT(prcnt, &kp PRCNT, n, o)
ZMK_COMBO_TAIPO_OT(amps , &kp AMPS , i, a)
ZMK_COMBO_TAIPO_OT(dllr , &kp DLLR , e, r)
ZMK_COMBO_TAIPO_OT(pipe , &kp PIPE , t, s)

ZMK_COMBO_TAIPO(sqt     , &kp SQT  , s, a)
ZMK_COMBO_TAIPO(semi    , &kp SEMI , o, r)
ZMK_COMBO_TAIPO(qmark   , &kp QMARK, i, t)
ZMK_COMBO_TAIPO(comma   , &kp COMMA, e, n)

ZMK_COMBO_TAIPO_IT(dqt  , &kp DQT  , s, a)
ZMK_COMBO_TAIPO_IT(colon, &kp COLON, o, r)
ZMK_COMBO_TAIPO_IT(excl , &kp EXCL , i, t)
ZMK_COMBO_TAIPO_IT(dot  , &kp DOT  , e, n)

ZMK_COMBO_TAIPO_OT(grave, &kp GRAVE, s, a)
ZMK_COMBO_TAIPO_OT(none1, &none    , o, r)
ZMK_COMBO_TAIPO_OT(none2, &none    , i, t)
ZMK_COMBO_TAIPO_OT(tilde, &kp TILDE, e, n)

ZMK_COMBO_TAIPO(enter   , &kp ENTER, e, t, o)
ZMK_COMBO_TAIPO(tab     , &kp TAB  , i, n, s)

ZMK_COMBO_TAIPO_IT(esc  , &kp ESC  , e, t, o)
ZMK_COMBO_TAIPO_IT(del  , &kp DEL  , i, n, s)

#ifndef TAIPO_PASTE_BINDING
#define TAIPO_PASTE_BINDING &kp LS(INSERT)
#endif

ZMK_COMBO_TAIPO_OT(paste, TAIPO_PASTE_BINDING, e, t, o)

// These need to be sticky, but clear with repeat presses.
ZMK_COMBO_TAIPO(gui     , &sk LGUI    , a, r)
ZMK_COMBO_TAIPO(alt     , &sk LALT    , o, s)
ZMK_COMBO_TAIPO(ctl     , &sk LCTRL   , t, n)
ZMK_COMBO_TAIPO(sft     , &sk LSHFT   , e, i)

// Enumerate all possible GACS combinations.
ZMK_COMBO_TAIPO(ga      , &sk LG(LALT)         , o, s, a, r)
ZMK_COMBO_TAIPO(gc      , &sk LG(LCTRL)        , t, n, a, r)
ZMK_COMBO_TAIPO(gs      , &sk LG(LSHFT)        , e, i, a, r)
ZMK_COMBO_TAIPO(ac      , &sk LA(LCTRL)        , t, n, o, s)
ZMK_COMBO_TAIPO(as      , &sk LA(LSHFT)        , e, i, o, s)
ZMK_COMBO_TAIPO(cs      , &sk LC(LSHFT)        , e, i, t, n)
ZMK_COMBO_TAIPO(gac     , &sk LG(LA(LCTRL))    , t, n, o, s, a, r)
ZMK_COMBO_TAIPO(gas     , &sk LG(LA(LSHFT))    , e, i, o, s, a, r)
ZMK_COMBO_TAIPO(gcs     , &sk LG(LC(LSHFT))    , e, i, t, n, a, r)
ZMK_COMBO_TAIPO(acs     , &sk LA(LC(LSHFT))    , e, i, t, n, o, s)
ZMK_COMBO_TAIPO(gacs    , &sk LG(LA(LC(LSHFT))), e, i, t, n, o, s, a, r)

// hjkl is left/down/up/right, so mirrored is right/up/down/left.
ZMK_COMBO_TAIPO_IT(right, &kp RIGHT, a, r)
ZMK_COMBO_TAIPO_IT(up   , &kp UP   , o, s)
ZMK_COMBO_TAIPO_IT(down , &kp DOWN , t, n)
ZMK_COMBO_TAIPO_IT(left , &kp LEFT , e, i)

// Deviation from the official Taipo layout: Home/PgDn/PgUp/End.
ZMK_COMBO_TAIPO_OT(home , &kp HOME , e, i)
ZMK_COMBO_TAIPO_OT(pgdn , &kp PG_DN, t, n)
ZMK_COMBO_TAIPO_OT(pgup , &kp PG_UP, o, s)
ZMK_COMBO_TAIPO_OT(end  , &kp END  , a, r)

// Taipo leader combo for F-key access. Depends on urob's zmk-leader-key
ZMK_COMBO_TAIPO_OT(lead, &tlead, i, n, s)

#define ZMK_TAIPO_LEADER_SEQUENCE(name, leader_bindings, leader_sequence) \
    / { \
        behaviors { \
            tlead: tlead { \
                compatible = "zmk,behavior-leader-key"; \
                #binding-cells = <0>; \
                ignore-keys = <LSHFT RSHFT>; \
                leader_sequence_ ## name { \
                    bindings = <leader_bindings>; \
                    sequence = <leader_sequence>; \
                }; \
            }; \
        }; \
    };

// leader 1-9: F1-F9
// leader 0 0-9: F10-F19
ZMK_TAIPO_LEADER_SEQUENCE(f1,  &kp F1,  N1)
ZMK_TAIPO_LEADER_SEQUENCE(f2,  &kp F2,  N2)
ZMK_TAIPO_LEADER_SEQUENCE(f3,  &kp F3,  N3)
ZMK_TAIPO_LEADER_SEQUENCE(f4,  &kp F4,  N4)
ZMK_TAIPO_LEADER_SEQUENCE(f5,  &kp F5,  N5)
ZMK_TAIPO_LEADER_SEQUENCE(f6,  &kp F6,  N6)
ZMK_TAIPO_LEADER_SEQUENCE(f7,  &kp F7,  N7)
ZMK_TAIPO_LEADER_SEQUENCE(f8,  &kp F8,  N8)
ZMK_TAIPO_LEADER_SEQUENCE(f9,  &kp F9,  N9)
ZMK_TAIPO_LEADER_SEQUENCE(f10, &kp F10, N0 N0)
ZMK_TAIPO_LEADER_SEQUENCE(f11, &kp F11, N0 N1)
ZMK_TAIPO_LEADER_SEQUENCE(f12, &kp F12, N0 N2)
ZMK_TAIPO_LEADER_SEQUENCE(f13, &kp F13, N0 N3)
ZMK_TAIPO_LEADER_SEQUENCE(f14, &kp F14, N0 N4)
ZMK_TAIPO_LEADER_SEQUENCE(f15, &kp F15, N0 N5)
ZMK_TAIPO_LEADER_SEQUENCE(f16, &kp F16, N0 N6)
ZMK_TAIPO_LEADER_SEQUENCE(f17, &kp F17, N0 N7)
ZMK_TAIPO_LEADER_SEQUENCE(f18, &kp F18, N0 N8)
ZMK_TAIPO_LEADER_SEQUENCE(f19, &kp F19, N0 N9)
